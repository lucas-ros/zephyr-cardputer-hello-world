## west.yml
```yaml
manifest:
  self:
    path: zephyr-cardputer-hello-world
  remotes:
    - name: zephyrproject-rtos
      url-base: https://github.com/zephyrproject-rtos
  projects:
    - name: zephyr
      remote: zephyrproject-rtos
      revision: v4.4.0
      import: true
```
